## CMakeLists.txt
```
# SPDX-License-Identifier: Apache-2.0

cmake_minimum_required(VERSION 3.20.0)

find_package(Zephyr REQUIRED HINTS $ENV{ZEPHYR_BASE})
project(zephyr_firmware_lab)

# cada linha dentro do target_sources adiciona um arquivo
# fonte (argumento) ao projeto

target_sources(app PRIVATE 
                        src/main.c 
                        src/button.c
                        src/led.c
                        src/app_events.c
                        src/led_thread.c
                        src/logging_thread.c
)

target_include_directories(app PRIVATE
    include
)
```

## prj.conf
```kconfig
CONFIG_EVENTS=y;
```

## app.overlay
```dts
/ {
    aliases {
        led0 = &led0;
    };

    leds {
        compatible = "gpio-leds";
        led0: led_0 {
            gpios = <&gpio0 2 GPIO_ACTIVE_HIGH>;
            label = "LED Vermelho";
        };
    };
};
```

## src/main.c
```c
/*
 * Copyright (c) 2012-2014 Wind River Systems, Inc.
 *
 * SPDX-License-Identifier: Apache-2.0
 */

/* Zephyr */
#include <zephyr/kernel.h>
#include <zephyr/sys/printk.h>

/* Application */
#include "led.h"
#include "button.h"
#include "led_thread.h"
#include "logging_thread.h"

int main(void)
{
	int led_ret, button_ret;
	
	/* Initialize hardware resources */
	led_ret = led_init();
	if (led_ret < 0) {
		printk("[MAIN] LED initialization failed: %d\n", led_ret);
		return led_ret;
	}
	
	button_ret = button_init();
	if (button_ret < 0) {
		printk("[MAIN] Button initialization failed: %d\n", button_ret);
		return button_ret;
	}

	/* Initialize application infrastructure */
	fifo_init();
	led_thread_init();
	log_thread_init();

	/* Log application start */
	fifo_producer(LOG_SRC_MAIN, LOG_EVT_INIT, 0);

	printk("[MAIN] Application initialized successfully\n");

	return 0;
}
```

## include/app_events.h
```c
#pragma once

#include <zephyr/kernel.h>

void app_event_publish(void);

int app_event_take(k_timeout_t timeout);
```

## include/button.h
```c
#pragma once

int button_init(void);
```

## include/led.h
```c
#pragma once

/* Initialize LED GPIO */
int led_init(void);

/* Turn LED on */
void led_on(void);

/* Turn LED off */
void led_off(void);

/* Toggle LED state */
void led_toggle(void);
```

## include/led_thread.h
```c
#pragma once

typedef enum {
    LED_OFF,
    LED_SLOW,
    LED_MEDIUM,
    LED_FAST
} led_mode_t;

void led_thread_init(void);
```

## include/logging_thread.h
```c
#pragma once

#include <zephyr/kernel.h>
#include <stdint.h>

/* Log message source */
typedef enum {
    LOG_SRC_MAIN,
    LOG_SRC_BUTTON,
    LOG_SRC_LED_THREAD,
} log_source_t;

/* Log event type */
typedef enum {
    LOG_EVT_INIT,
    LOG_EVT_BUTTON_PRESS,
    LOG_EVT_MODE_CHANGE,
    LOG_EVT_LED_TOGGLE,
    LOG_EVT_ERROR,
    LOG_EVT_INFO,
} log_event_t;

/* Log message structure */
typedef struct {
    void *fifo_reserved;   /* Reserved for FIFO internal use */
    log_source_t source;   /* Source of the log message */
    log_event_t event;     /* Event type */
    int32_t value;         /* Contextual value (e.g., LED mode) */
    uint32_t timestamp;    /* Timestamp in milliseconds */
} log_message_t;

/* Initialize the FIFO queue */
void fifo_init(void);

/* Initialize the logging thread */
void log_thread_init(void);

/* Produce a log message (thread-safe from ISR) */
void fifo_producer(log_source_t source, log_event_t event, int32_t value);
```

## src/app_events.c
```c
#include "app_events.h"

static K_SEM_DEFINE(app_event_sem, 0, K_SEM_MAX_LIMIT);

void app_event_publish(void)
{
    k_sem_give(&app_event_sem);
}

int app_event_take(k_timeout_t timeout)
{
    return k_sem_take(&app_event_sem, timeout);
}
```

## src/button.c
```c
/*
Button module: debounced GPIO button input with interrupt-driven event publishing.
Imposes a 50ms debounce delay to suppress mechanical noise and double-presses.
*/

/*Zephyr*/
#include <zephyr/kernel.h>
#include <zephyr/drivers/gpio.h>
#include <zephyr/sys/printk.h>

/* Application */
#include "app_events.h"
#include "logging_thread.h"

/* GPIO device tree specification for button */
static const struct gpio_dt_spec button = GPIO_DT_SPEC_GET(DT_ALIAS(sw0), gpios);

/* GPIO callback registration structure */
static struct gpio_callback button_cb;

/* Debounce state: timestamp of last valid press */
static int64_t last_press_time = 0;

/* Debounce interval in milliseconds */
#define DEBOUNCE_MS 50

/* Button press callback: debounced and published as event */
static void button_pressed( 
                        const struct device *dev, 
                        struct gpio_callback *cb,
                        gpio_port_pins_t pins) {
    ARG_UNUSED(dev);
    ARG_UNUSED(cb);
    ARG_UNUSED(pins);

    int64_t now = k_uptime_get();
    
    /* Reject press if within debounce window */
    if (now - last_press_time < DEBOUNCE_MS) {
        return;
    }
    
    last_press_time = now;
    
    app_event_publish();
    fifo_producer(LOG_SRC_BUTTON, LOG_EVT_BUTTON_PRESS, 0);
}

/* Initialize button GPIO and interrupt handler */
int button_init(void) {
    if (!device_is_ready(button.port)) {
        printk("[BUTTON] Device not ready\n");
        return -ENODEV;
    }

    int ret = gpio_pin_configure_dt(&button, GPIO_INPUT);
    if (ret < 0) {
        printk("[BUTTON] Failed to configure GPIO: %d\n", ret);
        return ret;
    }

    /* Initialize callback structure */
    gpio_init_callback(
                    &button_cb,
                    button_pressed,
                    BIT(button.pin)
    );

    /* Register callback with GPIO driver */
    ret = gpio_add_callback(button.port, &button_cb);
    if (ret < 0) {
        printk("[BUTTON] Failed to add callback: %d\n", ret);
        return ret;
    }

    /* Enable interrupts on button pin */
    ret = gpio_pin_interrupt_configure_dt(&button, GPIO_INT_EDGE_TO_ACTIVE);
    if (ret < 0) {
        printk("[BUTTON] Failed to configure interrupt: %d\n", ret);
        return ret;
    }

    return 0;
}
```

## src/led.c
```c
/*
LED module: low-level GPIO control abstraction.
Encapsulates the LED device configuration and provides basic control functions.
*/

/*Zephyr*/
#include <zephyr/kernel.h>
#include <zephyr/drivers/gpio.h>

/* GPIO device tree specification for LED */
static const struct gpio_dt_spec led = 
                GPIO_DT_SPEC_GET(DT_ALIAS(led0), gpios);

/* Initialize LED GPIO as output */
int led_init(void) {
    if (!device_is_ready(led.port)) {
        return -ENODEV;
    }

    int ret = gpio_pin_configure_dt(&led, GPIO_OUTPUT_INACTIVE);
    if (ret < 0) {
        return ret;
    }

    return 0;
}

/* Set LED to ON state */
void led_on(void) {
    gpio_pin_set_dt(&led, 1);
}

/* Set LED to OFF state */
void led_off(void) {
    gpio_pin_set_dt(&led, 0);
}

void led_toggle(void) {
    gpio_pin_toggle_dt(&led);
}
```

## src/led_thread.c
```c
/*
LED control thread: manages LED blinking modes with state machine.
Modes transition cyclically: OFF -> SLOW -> MEDIUM -> FAST -> OFF.
Each button press advances to the next mode.
*/

#include <zephyr/kernel.h>
#include <zephyr/sys/printk.h>

#include "led_thread.h"
#include "app_events.h"
#include "led.h"
#include "logging_thread.h"

/* Thread configuration */
#define STACK_SIZE 500
#define PRIORITY 3

K_THREAD_STACK_DEFINE(led_thread_stack, STACK_SIZE);

static struct k_thread led_thread;

/* Current operational mode of the LED */
static led_mode_t current_mode = LED_OFF;

/*
Compute the next LED mode in the cycle.
Transitions: OFF -> SLOW -> MEDIUM -> FAST -> OFF
*/
static led_mode_t next_mode(led_mode_t mode)
{
    switch (mode) {
    case LED_OFF:
        return LED_SLOW;
    case LED_SLOW:
        return LED_MEDIUM;
    case LED_MEDIUM:
        return LED_FAST;
    case LED_FAST:
    default:
        return LED_OFF;
    }
}

/*
Get the blink period (toggle interval) for each mode.
- OFF: infinite (no timeout, waits for button)
- SLOW: 1 second (0.5s on, 0.5s off)
- MEDIUM: 500ms (0.25s on, 0.25s off)
- FAST: 200ms (0.1s on, 0.1s off)
*/
static k_timeout_t mode_timeout(led_mode_t mode)
{
    switch (mode) {
    case LED_SLOW:
        return K_MSEC(1000);
    case LED_MEDIUM:
        return K_MSEC(500);
    case LED_FAST:
        return K_MSEC(200);
    case LED_OFF:
    default:
        return K_FOREVER;
    }
}

static void led_thread_entry(void *arg1, void *arg2, void *arg3)
{
    ARG_UNUSED(arg1);
    ARG_UNUSED(arg2);
    ARG_UNUSED(arg3);

    printk("[LED THREAD] Running\n");

    while (1) {
        switch (current_mode) {
        case LED_SLOW:
        case LED_MEDIUM:
        case LED_FAST: {
            /* Blink modes: toggle and check for event */
            led_toggle();
            
            int ret = app_event_take(mode_timeout(current_mode));
            if (ret == 0) {
                /* Button pressed: transition to next mode */
                current_mode = next_mode(current_mode);
                fifo_producer(LOG_SRC_LED_THREAD, LOG_EVT_MODE_CHANGE, current_mode);
            }
            break;
        }
        case LED_OFF:
            /* OFF mode: ensure LED is off and wait indefinitely */
            led_off();

            int ret = app_event_take(K_FOREVER);
            if (ret == 0) {
                /* Button pressed: transition to next mode (SLOW) */
                current_mode = next_mode(current_mode);
                fifo_producer(LOG_SRC_LED_THREAD, LOG_EVT_MODE_CHANGE, current_mode);
            }
            break;
        default:
            /* Invalid state: recover to OFF */
            printk("[LED THREAD] Invalid mode: %d, recovering\n", current_mode);
            current_mode = LED_OFF;
            break;
        }
    }
}

void led_thread_init(void) {
    k_thread_create(&led_thread, led_thread_stack, K_THREAD_STACK_SIZEOF(led_thread_stack),
                    led_thread_entry, NULL, NULL, NULL,
                    PRIORITY, 0, K_NO_WAIT);
}
```

## src/logging_thread.c
```c
/*
Logging thread module: event log buffering and output.
Uses FIFO queue and memory slab for thread-safe, ISR-safe event logging.
Consumer thread dequeues and outputs messages to console in order.
*/

#include <zephyr/kernel.h>
#include <zephyr/sys/printk.h>

#include "logging_thread.h"

/* Logging thread configuration */
#define STACK_SIZE 500
#define PRIORITY 2

K_THREAD_STACK_DEFINE(log_stack, STACK_SIZE);

static struct k_thread log_thread;

/* FIFO queue for log message buffering */
struct k_fifo queue;

/* Memory slab for log message allocation */
K_MEM_SLAB_DEFINE(log_slab, sizeof(log_message_t), 10, 4);

/* Producer: allocate and queue a log message (safe from ISR context) */
void fifo_producer(log_source_t source, log_event_t event, int32_t value) {
    log_message_t *tx_data;

    if (k_mem_slab_alloc(&log_slab, (void **) &tx_data, K_NO_WAIT) == 0) {
        tx_data->source = source;
        tx_data->event = event;
        tx_data->value = value;
        tx_data->timestamp = k_uptime_get_32();

        k_fifo_put(&queue, tx_data);
    }
}

/* Consumer thread: dequeues log messages and outputs them */
void fifo_consumer(void *p1, void *p2, void *p3) {
    ARG_UNUSED(p1);
    ARG_UNUSED(p2);
    ARG_UNUSED(p3);

    log_message_t *rx_data;

    printk("[LOGGING THREAD] Started\n");

    while (1) {
        rx_data = k_fifo_get(&queue, K_FOREVER);

        /* Format and print log message */
        printk("[LOG] src=%u evt=%u val=%d ts=%u ms\n", 
                rx_data->source,
                rx_data->event,
                rx_data->value,
                rx_data->timestamp);
        
        /* Free allocated memory back to slab */
        k_mem_slab_free(&log_slab, (void **)&rx_data);
    }
}

/* Initialize FIFO queue */
void fifo_init(void) {
    k_fifo_init(&queue);
}

/* Initialize logging thread */
void log_thread_init(void) {
    k_thread_create(&log_thread, log_stack, STACK_SIZE,
                    fifo_consumer, NULL, NULL, NULL,
                    PRIORITY, 0, K_NO_WAIT);
}
```
